// ПРИМЕР УПРАВЛЕНИЯ НАСОСАМИ С ПРОВЕРКОЙ:                                         //
// Управление насосами без проверки доступно в примере "setOnOffShort"             //
                                                                                   //
#include <SoftwareSerial.h>                                                        //   Подключаем библиотеку для работы с программной шиной UART.
#include <iarduino_Modbus.h>                                                       //   Подключаем библиотеку для работы по протоколу Modbus.
#include <iarduino_MB_Pump.h>                                                      //   Подключаем библиотеку для работы с насосами.
                                                                                   //
SoftwareSerial   rs485(8,9);                                                       //   Создаём объект для работы с программной шиной UART-RS485 указывая выводы RX, TX.
ModbusClient     modbus(rs485, 2);                                                 //   Создаём объект для работы по протоколу Modbus указывая объект программной шины UART-RS485 и вывод DE конвертера UART-RS485.
iarduino_MB_Pump pump(modbus);                                                     //   Создаём объект для работы с насосами указывая объект протокола Modbus.
                                                                                   //
void setup(){                                                                      //
     Serial.begin(9600);   while(!Serial);                                         //   Инициируем передачу данных в монитор последовательного порта, указав его скорость.
     rs485.begin(9600); // while(!rs485 );                                         //   Инициируем работу с программной шиной UART-RS485 указав её скорость.
     modbus.begin();                                                               //   Инициируем работу по протоколу Modbus.
//   modbus.setTimeout(10);                                                        //   Указываем максимальное время ожидания ответа по протоколу Modbus.
//   modbus.setDelay(4);                                                           //   Указываем минимальный интервал между отправляемыми сообщениями по протоколу Modbus.
//   modbus.setTypeMB( MODBUS_RTU );                                               //   Указываем тип протокола Modbus: MODBUS_RTU (по умолчанию), или MODBUS_ASCII.
     pump.begin(2);                                                                //   Инициируем работу с насосами, указав адрес модуля. Если адрес не указан pump.begin(), то он будет найден, но это займёт некоторое время.
//   pump.setFrequency(PUMP_ALL, 500, 1000, 2000);                                 //   Указываем частоту ШИМ для управления мощностью насосов A,B,C (по умолчанию 1000Гц). В примере: A=500Гц, B=1000Гц, C=2000Гц.
//   pump.setFrequency(PUMP_ALL, 500, 1000);                                       //   Указываем частоту ШИМ для управления мощностью насосов A,B (для модуля с двумя насосами).
//   pump.setPower(PUMP_ALL, 192, 128, 64);                                        //   Указываем мощность насосов A,B,C (по умолчанию 100%). В примере: A=192=75%, B=128=50%, C=64=25%.
//   pump.setPower(PUMP_ALL, 192, 128);                                            //   Указываем мощность насосов A,B (для модуля с двумя насосами).
}                                                                                  //
                                                                                   //
void loop(){                                                                       //
     int i;                                                                        //
                                                                                   //
//   Включаем насос A:                                                             //
     Serial.print("Включаем насос A:");                                            //
     i=pump.setState(PUMP_A, true);                                                //   Отправляем команду включения насоса A.
     if( i ){ Serial.print(" Ок. "); }else{ Serial.print(" Err. "); }              //   Выводим результат выполнения команды.
//   Проверяем состояние насоса A:                                                 //
     i=pump.getState(PUMP_A);                                                      //   Получаем состояние насоса A.
     if( i==1 ){ Serial.println("Насос A включен." ); }else                        //   Выводим  состояние насоса A.
     if( i==0 ){ Serial.println("Насос A отключен."); }else                        //   Выводим  состояние насоса A.
               { Serial.println("Состояние насоса A неизвестно." ); }              //   Выводим  состояние насоса A.
     delay(1000);                                                                  //   Ждём 1 секунду.
                                                                                   //
//   Отключаем насос A:                                                            //
     Serial.print("Отключаем насос A:");                                           //
     i=pump.setState(PUMP_A, false);                                               //   Отправляем команду отключения насоса A.
     if( i ){ Serial.print(" Ок. "); }else{ Serial.print(" Err. "); }              //   Выводим результат выполнения команды.
//   Проверяем состояние насоса A:                                                 //
     i=pump.getState(PUMP_A);                                                      //   Получаем состояние насоса A.
     if( i==1 ){ Serial.println("Насос A включен." ); }else                        //   Выводим  состояние насоса A.
     if( i==0 ){ Serial.println("Насос A отключен."); }else                        //   Выводим  состояние насоса A.
               { Serial.println("Состояние насоса A неизвестно." ); }              //   Выводим  состояние насоса A.
     delay(1000);                                                                  //   Ждём 1 секунду.
                                                                                   //
//   Включаем насос B:                                                             //
     Serial.print("Включаем насос B:");                                            //
     i=pump.setState(PUMP_B, true);                                                //   Отправляем команду включения насоса B.
     if( i ){ Serial.print(" Ок. "); }else{ Serial.print(" Err. "); }              //   Выводим результат выполнения команды.
//   Проверяем состояние насоса B:                                                 //
     i=pump.getState(PUMP_B);                                                      //   Получаем состояние насоса B.
     if( i==1 ){ Serial.println("Насос B включен." ); }else                        //   Выводим  состояние насоса B.
     if( i==0 ){ Serial.println("Насос B отключен."); }else                        //   Выводим  состояние насоса B.
               { Serial.println("Состояние насоса B неизвестно." ); }              //   Выводим  состояние насоса B.
     delay(1000);                                                                  //   Ждём 1 секунду.
                                                                                   //
//   Отключаем насос B:                                                            //
     Serial.print("Отключаем насос B:");                                           //
     i=pump.setState(PUMP_B, false);                                               //   Отправляем команду отключения насоса B.
     if( i ){ Serial.print(" Ок. "); }else{ Serial.print(" Err. "); }              //   Выводим результат выполнения команды.
//   Проверяем состояние насоса B:                                                 //
     i=pump.getState(PUMP_B);                                                      //   Получаем состояние насоса B.
     if( i==1 ){ Serial.println("Насос B включен." ); }else                        //   Выводим  состояние насоса B.
     if( i==0 ){ Serial.println("Насос B отключен."); }else                        //   Выводим  состояние насоса B.
               { Serial.println("Состояние насоса B неизвестно." ); }              //   Выводим  состояние насоса B.
     delay(1000);                                                                  //   Ждём 1 секунду.
                                                                                   //
//   Включаем насос C:                                                             //
     Serial.print("Включаем насос C:");                                            //
     i=pump.setState(PUMP_C, true);                                                //   Отправляем команду включения насоса C.
     if( i ){ Serial.print(" Ок. "); }else{ Serial.print(" Err. "); }              //   Выводим результат выполнения команды.
//   Проверяем состояние насоса C:                                                 //
     i=pump.getState(PUMP_C);                                                      //   Получаем состояние насоса C.
     if( i==1 ){ Serial.println("Насос C включен." ); }else                        //   Выводим  состояние насоса C.
     if( i==0 ){ Serial.println("Насос C отключен."); }else                        //   Выводим  состояние насоса C.
               { Serial.println("Состояние насоса C неизвестно." ); }              //   Выводим  состояние насоса C.
     delay(1000);                                                                  //   Ждём 1 секунду.
                                                                                   //
//   Отключаем насос C:                                                            //
     Serial.print("Отключаем насос C:");                                           //
     i=pump.setState(PUMP_C, false);                                               //   Отправляем команду отключения насоса C.
     if( i ){ Serial.print(" Ок. "); }else{ Serial.print(" Err. "); }              //   Выводим результат выполнения команды.
//   Проверяем состояние насоса C:                                                 //
     i=pump.getState(PUMP_C);                                                      //   Получаем состояние насоса C.
     if( i==1 ){ Serial.println("Насос C включен." ); }else                        //   Выводим  состояние насоса C.
     if( i==0 ){ Serial.println("Насос C отключен."); }else                        //   Выводим  состояние насоса C.
               { Serial.println("Состояние насоса C неизвестно." ); }              //   Выводим  состояние насоса C.
     delay(1000);                                                                  //   Ждём 1 секунду.
                                                                                   //
//   Управляем всеми насосами сразу:                                               //
     Serial.print("Управляем всеми насосами: A-вкл, B-выкл, C-вкл:");              //
     i=pump.setState(PUMP_ALL, true, false, true);                                 //   Отправляем команду управления всеми насосами: A-вкл, B-выкл, C-вкл.
     if( i ){ Serial.print(" Ок. "); }else{ Serial.print(" Err. "); }              //   Выводим результат выполнения команды.
//   Проверяем состояние всех насосов сразу:                                       //
     Serial.print("Текущее состояние насосов: ");                                  //
     i=pump.getState(PUMP_ALL);                                                    //   
     if( i<0 ){                                                                    //
        Serial.print("A=err, B=err, C=err");                                       //   Выводим сообщение об ошибке.
     }else{                                                                        //
        Serial.print(  "A="); Serial.print( bitRead(i,0) );                        //   Выводим значение 0 бита байта i, который отражает состояние насоса A.
        Serial.print(", B="); Serial.print( bitRead(i,2) );                        //   Выводим значение 1 бита байта i, который отражает состояние насоса B.
        Serial.print(", C="); Serial.print( bitRead(i,4) );                        //   Выводим значение 2 бита байта i, который отражает состояние насоса C.
     }                                                                             //
     Serial.println('.');                                                          //
     delay(1000);                                                                  //   Ждём 1 секунду.
                                                                                   //
//   Управляем всеми насосами сразу:                                               //
     Serial.print("Управляем всеми насосами: A-выкл, B-выкл, C-выкл:");            //
     i=pump.setState(PUMP_ALL, false, false, false);                               //   Отправляем команду управления всеми насосами: A-выкл, B-выкл, C-выкл.
     if( i ){ Serial.print(" Ок. "); }else{ Serial.print(" Err. "); }              //   Выводим результат выполнения команды.
//   Проверяем состояние всех насосов сразу:                                       //
     Serial.print("Текущее состояние насосов: ");                                  //
     i=pump.getState(PUMP_ALL);                                                    //   
     if( i<0 ){                                                                    //
        Serial.print("A=err, B=err, C=err");                                       //   Выводим сообщение об ошибке.
     }else{                                                                        //
        Serial.print(  "A="); Serial.print( bitRead(i,0) );                        //   Выводим значение 0 бита байта i, который отражает состояние насоса A.
        Serial.print(", B="); Serial.print( bitRead(i,1) );                        //   Выводим значение 1 бита байта i, который отражает состояние насоса B.
        Serial.print(", C="); Serial.print( bitRead(i,2) );                        //   Выводим значение 2 бита байта i, который отражает состояние насоса C.
     }                                                                             //
     Serial.println('.');                                                          //
     delay(1000);                                                                  //   Ждём 1 секунду.
}